## conf/machine/beaglev-ahead-th1520.conf
```bitbake
#@TYPE: Machine
#@NAME: beaglev-ahead-th1520
#@SOC: T-Head TH1520
#@DESCRIPTION: Machine configuration for the BeagleV-Ahead board

require conf/machine/include/riscv/tune-riscv.inc

MACHINE_FEATURES = "screen keyboard ext2 ext3 serial"

KERNEL_CLASSES = "kernel-fitimage"
#KERNEL_IMAGETYPE = "fitImage"
KERNEL_IMAGETYPE = "Image"
KERNEL_DEVICETREE ?= "thead/th1520-beaglev-ahead.dtb"

PREFERRED_PROVIDER_virtual/kernel ?= "linux-beaglev-ahead-dev"
PREFERRED_PROVIDER_virtual/bootloader ?= "u-boot-beaglev-ahead"

PREFERRED_VERSION_openocd-native = "riscv"
PREFERRED_VERSION_openocd = "riscv"

EXTRA_IMAGEDEPENDS += "opensbi"
RISCV_SBI_PLAT = "generic"

## This sets u-boot as the default OpenSBI payload
#RISCV_SBI_PAYLOAD ?= "u-boot.bin"

RISCV_SBI_FDT ?= "th1520-beaglev-ahead.dtb"

SERIAL_CONSOLES = "115200;ttyS0"

MACHINE_EXTRA_RRECOMMENDS += " kernel-modules"

IMAGE_FSTYPES += "wic.gz wic.bmap ext4"

EXTRA_IMAGEDEPENDS += "u-boot-beaglev-ahead"
UBOOT_MACHINE = "light_beagle_defconfig"

UBOOT_ENTRYPOINT = "0x40200000"
UBOOT_DTB_LOADADDRESS = "0x46000000"
#SPL_BINARY = "spl/u-boot-spl"
UBOOT_ELF = "u-boot"
UBOOT_BINARY = "u-boot-with-spl.bin"
#UBOOT_DTB = "1"
#UBOOT_DTB_BINARY = "starfive_vic7100_beagle_v.dtb"

## wic default support
WKS_FILE_DEPENDS ?= " \
    u-boot-beaglev-ahead \
    opensbi \
    e2fsprogs-native \
    bmap-tools-native \
"

IMAGE_BOOT_FILES ?= " \
    ${KERNEL_IMAGETYPE} \
    fw_dynamic.bin \
    ${RISCV_SBI_FDT}  \
"

WKS_FILE ?= "beaglev-ahead.wks"
```

## conf/machine/smarc-rzfive.conf
```bitbake
#@TYPE: Machine
#@NAME: smarc-rzfive
#@SOC: Renesas RZ/Five SMARC Board (R9A07G043F)
#@DESCRIPTION: Machine configuration for Renesas RZ/Five

require conf/machine/include/riscv/tune-riscv.inc

MACHINE_FEATURES = "screen keyboard ext2 ext3 serial"

KERNEL_CLASSES = "kernel-fitimage"
KERNEL_IMAGETYPE = "fitImage"
KERNEL_ALT_IMAGETYPE = "Image"
KERNEL_DEVICETREE ?= "renesas/r9a07g043f01-smarc.dtb"

PREFERRED_PROVIDER_virtual/kernel ?= "linux-smarc-rzfive-dev"
PREFERRED_PROVIDER_virtual/bootloader ?= "u-boot-smarc-rzfive"

EXTRA_IMAGEDEPENDS += "opensbi-smarc-rzfive"
RISCV_SBI_PLAT = "generic"
RISCV_SBI_FDT ?= "r9a07g043f01-smarc.dtb"

SERIAL_CONSOLES = "115200;ttySC0"

MACHINE_EXTRA_RRECOMMENDS += " kernel-modules"

IMAGE_FSTYPES ?= "wic.gz ext4 tar.bz2"


EXTRA_IMAGEDEPENDS += "u-boot-smarc-rzfive"
UBOOT_MACHINE = "smarc-rzf_defconfig"

# U-Boot SPL
SPL_BINARY ?= "spl/u-boot-spl.bin"

# U-Boot ITB (FIT image with U-Boot S-mode, OpenSBI FW_DYNAMIC, DTB [from
# U-Boot source code tree])
UBOOT_SUFFIX ?= "itb"

# This will be load addresses and entry points of fitImage.its
UBOOT_ENTRYPOINT = "0x48080000"
UBOOT_DTB_LOADADDRESS = "0x48000000"

## wic default support
WKS_FILE_DEPENDS ?= " \
    u-boot-smarc-rzfive \
    opensbi-smarc-rzfive \
    e2fsprogs-native \
    bmap-tools-native \
"

#IMAGE_BOOT_FILES ?= " \
#    ${KERNEL_IMAGETYPE} \
#    Image-smarc-rzfive.bin \
#    ${RISCV_SBI_FDT} \
#    boot.scr.uimg \
#    uEnv.txt \
#    u-boot.itb \
#    u-boot-spl.bin \
#"

# U-Boot default bootcmd:
# => mmc dev 1
# => fatload mmc 1:1 0x48080000 Image-smarc-rzfive.bin
# => fatload mmc 1:1 0x48000000 r9a07g043f01-smarc.dtb
# => booti 0x48080000 - 0x48000000
IMAGE_BOOT_FILES ?= " \
    Image-smarc-rzfive.bin \
    ${RISCV_SBI_FDT} \
"

EXTRA_IMAGEDEPENDS += " flash-writer"

WKS_FILE ?= "smarc-rzfive.wks"
```

## conf/machine/tinker-v-rzfive.conf
```bitbake
#@TYPE: Machine
#@NAME: tinker-v-rzfive
#@SOC: Renesas RZ/Five (R9A07G043F)
#@DESCRIPTION: Machine configuration for ASUS Tinker-V board

require conf/machine/include/riscv/tune-riscv.inc

MACHINE_FEATURES = "screen keyboard ext2 ext3 serial"

KERNEL_CLASSES = "kernel-fitimage"
KERNEL_IMAGETYPE = "fitImage"
KERNEL_ALT_IMAGETYPE = "Image"
KERNEL_DEVICETREE ?= "renesas/r9a07g043f01-tinker-v.dtb"

PREFERRED_PROVIDER_virtual/kernel ?= "linux-tinker-v-rzfive-dev"
PREFERRED_PROVIDER_virtual/bootloader ?= "u-boot-tinker-v-rzfive"

EXTRA_IMAGEDEPENDS += "opensbi"
RISCV_SBI_PLAT = "generic"
RISCV_SBI_FDT ?= "r9a07g043f01-tinker-v.dtb"

SERIAL_CONSOLES = "115200;ttySC0"

MACHINE_EXTRA_RRECOMMENDS += " kernel-modules"

IMAGE_FSTYPES ?= "wic.gz ext4 tar.bz2"

EXTRA_IMAGEDEPENDS += "u-boot-tinker-v-rzfive"
UBOOT_MACHINE = "tinker_v_defconfig"

## wic default support
WKS_FILE_DEPENDS ?= " \
    u-boot-tinker-v-rzfive \
    opensbi \
    e2fsprogs-native \
    bmap-tools-native \
"

IMAGE_BOOT_FILES ?= " \
    Image-tinker-v-rzfive.bin \
    ${RISCV_SBI_FDT} \
"

EXTRA_IMAGEDEPENDS += " flash-writer"

WKS_FILE ?= "tinker-v-rzfive.wks"
```

## wic/beaglev-ahead.wks
```
# short-description: Create SD card image for BeagleV-Ahead (TH1520)

part /boot --source bootimg-partition --ondisk mmcblk0 --fstype=ext4 --label boot --active --fixed-size 64M --align 4096
part / --source rootfs --ondisk mmcblk0 --fstype=ext4 --label root --align 4096 --part-type 80a5a8e9-c744-491a-93c1-4f4194fd690a

bootloader --ptable gpt
```

## wic/tinker-v-rzfive.wks
```
# short-description: Create SD card image for RZ/Five (AX45MP Single)

part /boot --source bootimg-partition --ondisk mmcblk0 --fstype=vfat --label boot --active --fixed-size 256M --align 4096
part / --source rootfs --ondisk mmcblk0 --fstype=ext4 --label root --align 4096 --size 64M
```
